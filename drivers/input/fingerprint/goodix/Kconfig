## drivers/input/fingerprint/goodix/Kconfig
```kconfig
config FINGERPRINT_GOODIX_GF3208
	bool "Goodix GF3208 fingerprint driver support"
	depends on FINGERPRINT
	help
	  Say Y here to enable goodix fingerprint driver support!
```
